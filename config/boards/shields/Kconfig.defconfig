## config/boards/shields/Kconfig.defconfig
```kconfig
if SHIELD_WHEEEBOARD_LEFT

# Name must be less than 16 characters long!
config ZMK_KEYBOARD_NAME
    default "WheeeBoard"

config ZMK_SPLIT_ROLE_CENTRAL
    default y

endif

if SHIELD_WHEEEBOARD_LEFT || SHIELD_WHEEEBOARD_RIGHT

config ZMK_SPLIT
    default y

endif
```
